## src/socsim/resources/rocket_software/zephyr/boards/usp/usp_rocket_rv64/Kconfig.defconfig
```kconfig
# SPDX-License-Identifier: Apache-2.0
if BOARD_USP_ROCKET_RV64
config BOARD
	default "usp_rocket_rv64"
endif
```

## src/socsim/resources/rocket_software/zephyr/boards/usp/usp_rocket_rv64/Kconfig.usp_rocket_rv64
```kconfig
# SPDX-License-Identifier: Apache-2.0
config BOARD_USP_ROCKET_RV64
	select SOC_USP_ROCKET_RV64
```

## src/socsim/resources/rocket_software/zephyr/boards/usp/usp_rocket_rv64/board.yml
```yaml
# SPDX-License-Identifier: Apache-2.0
board:
  name: usp_rocket_rv64
  vendor: usp
  socs:
    - name: usp_rocket_rv64
```

## src/socsim/resources/rocket_software/zephyr/boards/usp/usp_rocket_rv64/usp_rocket_rv64_defconfig
```kconfig
# SPDX-License-Identifier: Apache-2.0
CONFIG_SERIAL=y
CONFIG_CONSOLE=y
CONFIG_UART_CONSOLE=y
CONFIG_XIP=n
CONFIG_RISCV_PMP=n
CONFIG_GEN_IRQ_VECTOR_TABLE=y
```

## src/socsim/resources/rocket_software/zephyr/soc/usp/usp_rocket_rv64/Kconfig
```kconfig
# SPDX-License-Identifier: Apache-2.0
config SOC_USP_ROCKET_RV64
    select RISCV
    select 64BIT
    select RISCV_PRIVILEGED
    select INCLUDE_RESET_VECTOR
    select RISCV_ISA_RV64I
    select RISCV_ISA_EXT_A
    select RISCV_ISA_EXT_M
    select RISCV_ISA_EXT_C
    select RISCV_ISA_EXT_ZICSR
    select RISCV_ISA_EXT_ZIFENCEI
    select RISCV_HAS_PLIC
    select RISCV_SOC_HAS_GP_RELATIVE_ADDRESSING
```

## src/socsim/resources/rocket_software/zephyr/soc/usp/usp_rocket_rv64/Kconfig.soc
```kconfig
# SPDX-License-Identifier: Apache-2.0
config SOC_USP_ROCKET_RV64
	bool
config SOC
	default "usp_rocket_rv64" if SOC_USP_ROCKET_RV64
```

## src/socsim/resources/zephyr_rtl/boards/usp/usp_rv32/Kconfig.defconfig
```kconfig
# SPDX-License-Identifier: Apache-2.0
if BOARD_USP_RV32
config BOARD
	default "usp_rv32"
endif
```

## src/socsim/resources/zephyr_rtl/boards/usp/usp_rv32/Kconfig.usp_rv32
```kconfig
# SPDX-License-Identifier: Apache-2.0
config BOARD_USP_RV32
	select SOC_USP_RV32
```

## src/socsim/resources/zephyr_rtl/boards/usp/usp_rv32/board.yml
```yaml
# SPDX-License-Identifier: Apache-2.0
board:
  name: usp_rv32
  vendor: usp
  socs:
    - name: usp_rv32
```

## src/socsim/resources/zephyr_rtl/soc/usp/usp_rv32/Kconfig.defconfig.in
```kconfig
# SPDX-License-Identifier: Apache-2.0
if SOC_USP_RV32
config SYS_CLOCK_HW_CYCLES_PER_SEC
    default $timebase_hz
config RISCV_SOC_INTERRUPT_INIT
    default y
config 2ND_LVL_ISR_TBL_OFFSET
    default 12
config 2ND_LVL_INTR_00_OFFSET
    default 11
config 2ND_LEVEL_INTERRUPT_BITS
    default 6
config MAX_IRQ_PER_AGGREGATOR
    default 32
config NUM_IRQS
    default 44
endif
```

## src/socsim/resources/zephyr_rtl/soc/usp/usp_rv32/Kconfig.soc
```kconfig
# SPDX-License-Identifier: Apache-2.0
config SOC_USP_RV32
	bool
config SOC
	default "usp_rv32" if SOC_USP_RV32
```
