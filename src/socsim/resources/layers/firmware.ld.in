/* SPDX-License-Identifier: Apache-2.0 */
OUTPUT_ARCH(riscv)
ENTRY(_start)
INCLUDE memory.ld
SECTIONS {
 . = ORIGIN(RAM);
 .text : { KEEP(*(.text.init)) *(.text .text.*) } > RAM
 .rodata : { *(.rodata .rodata.*) } > RAM
 .data : { *(.data .data.* .sdata .sdata.*) } > RAM
 .bss (NOLOAD) : {
  . = ALIGN(16); __bss_start = .; *(.bss .bss.* .sbss .sbss.*) *(COMMON)
  . = ALIGN(16); __bss_end = .;
 } > RAM
 __stack_top = ORIGIN(RAM) + LENGTH(RAM) - 16;
 /DISCARD/ : { *(.comment .note .note.* .eh_frame .eh_frame.*) }
}
